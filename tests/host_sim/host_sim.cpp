// Host simulator of the REAL smart_parking_v9 firmware (the .ino is #included unmodified).
// It replaces the hardware: serial port, clock, the two HC-SR04 sensors, the LED and the web server.
//
// Interactive mode (what run_tests.ps1 -Sim uses): host_sim.exe
//   * real clock; setup() once, then loop() forever, exactly like the board
//   * stdin  -> Serial RX. Lines starting with '~' are simulator controls instead:
//       ~entrance <cm>   distance the entrance sensor sees   (default 30 = empty; <17.5 = car)
//       ~spot <cm>       distance the spot-0 sensor sees      (default 25.8 = empty; <22.5 = car)
//       ~glitch <pct>    electrical noise on the spot sensor: bursts of <2 cm / no-echo readings
//       ~spike <pct> [cm]  single believable-but-false readings (default 15 cm = "car") on the spot sensor
//       ~led             print the LED level          ->  [SIM] led=0|1
//       ~http state      call the /state handler      ->  [HTTP] <json>
//       ~http root       call the / handler           ->  [HTTP] root code=.. type=.. bytes=..
//       ~ping            ->  [SIM] pong   (lets a test wait until earlier input was processed)
//   * stdout -> Serial TX
//
// Batch mode: host_sim.exe --script file.txt   (fake clock, loop() is NOT run)
//   > <command>      run a Serial command           @advance <ms>   move the clock
//   @tick            checkReservationTimeouts()     @jsonout        print [JSON] <state>
//   @arrive/@leave   confirmed spot-0 sensor events @print <text>   echo a marker line
#include "arduino_shim.h"
#include "WiFi.h"
#include "WebServer.h"
#include <deque>
#include <fstream>
#include <string>

int osReadStdin(char*, int);
unsigned long osNowMs();
void osSleepMs(unsigned);
void osBinaryStdout();

SerialShim Serial;
WiFiClass WiFi;
std::string lastBody, lastType;
int lastCode = 0;
const char* lastPgm = nullptr;

static bool realClock = false;
static unsigned long fakeMs = 0, startMs = 0;
unsigned long millis() { return realClock ? osNowMs() - startMs : fakeMs; }
void delay(unsigned long ms) { if (realClock) osSleepMs((unsigned)ms); else fakeMs += ms; }

static double simEntranceCm = 30.0, simSpotCm = 25.8;
static int glitchPct = 0, burstLeft = 0, glitchKind = 0, simLed = 0;
static int spikePct = 0;            // chance per spot reading of ONE believable-but-false value (a real echo glitch)
static double spikeCm = 15.0;
static unsigned rngState = 12345;
static unsigned rnd() { rngState = rngState * 1103515245u + 12345u; return (rngState >> 16) & 0x7fff; }

static std::deque<char> rxq;
static std::string pend;
static bool stdinEof = false;
static void handleControl(const std::string& line);

static void pump() {
  if (stdinEof || !realClock) return;
  char buf[4096];
  for (;;) {
    int n = osReadStdin(buf, sizeof buf);
    if (n < 0) { stdinEof = true; break; }
    if (n == 0) break;
    pend.append(buf, (size_t)n);
  }
  // .NET puts a UTF-8 byte-order mark in front of the first thing it writes to a child's stdin.
  // A real serial line never carries one, so drop it (test-infrastructure quirk, not firmware behaviour).
  static bool bomChecked = false;
  if (!bomChecked && pend.size() >= 3) {
    bomChecked = true;
    if (pend.compare(0, 3, "\xEF\xBB\xBF") == 0) pend.erase(0, 3);
  }
  size_t p;
  while ((p = pend.find('\n')) != std::string::npos) {
    std::string line = pend.substr(0, p + 1);
    pend.erase(0, p + 1);
    if (line[0] == '~') handleControl(line);
    else for (char c : line) rxq.push_back(c);
  }
}
int serialAvailable() { pump(); return (int)rxq.size(); }
int serialRead() { if (rxq.empty()) return -1; char c = rxq.front(); rxq.pop_front(); return (unsigned char)c; }

#include "sketch_include.h"   // generated by build.ps1: #includes the real firmware, unmodified

void digitalWrite(int pin, int value) { if (pin == ledPin) simLed = value; }

long pulseIn(int pin, int, unsigned long) {
  double cm = (pin == echoPin1) ? simEntranceCm : simSpotCm;
  if (pin == echoPin2 && spikePct > 0 && (int)(rnd() % 100) < spikePct) cm = spikeCm;   // one-reading false value
  if (pin == echoPin2 && glitchPct > 0) {
    if (burstLeft == 0 && (int)(rnd() % 100) < glitchPct) { burstLeft = 1 + (int)(rnd() % 4); glitchKind = (int)(rnd() % 2); }
    if (burstLeft > 0) { burstLeft--; return glitchKind ? 0 : 2; }   // no echo, or a ~0.03 cm electrical blip
  }
  if (cm <= 0) return 0;
  return (long)(cm * 29.1 * 2.0);
}

static void handleControl(const std::string& line) {
  char cmd[32] = {0}, arg[64] = {0}, arg2[64] = {0};
  sscanf(line.c_str(), "~%31s %63s %63s", cmd, arg, arg2);
  std::string c = cmd;
  if (c == "entrance") simEntranceCm = atof(arg);
  else if (c == "spot") simSpotCm = atof(arg);
  else if (c == "spike") { spikePct = atoi(arg); if (arg2[0]) spikeCm = atof(arg2); }
  else if (c == "glitch") { glitchPct = atoi(arg); burstLeft = 0; }
  else if (c == "led") printf("[SIM] led=%d\n", simLed);
  else if (c == "ping") printf("[SIM] pong\n");
  else if (c == "http") {
#if ENABLE_WEB_VIEW
    if (!strcmp(arg, "state")) { handleWebState(); printf("[HTTP] %s\n", lastBody.c_str()); }
    else { handleWebRoot(); printf("[HTTP] root code=%d type=%s bytes=%zu\n", lastCode, lastType.c_str(), strlen(lastPgm)); }
#else
    printf("[HTTP] n/a (ENABLE_WEB_VIEW 0)\n");
#endif
  }
  else if (c == "quit") exit(0);
}

static int runScript(const char* path) {
  std::ifstream in(path);
  if (!in) { fprintf(stderr, "cannot open %s\n", path); return 2; }
  setup();
  std::string line;
  while (std::getline(in, line)) {
    if (!line.empty() && line.back() == '\r') line.pop_back();
    if (line.empty() || line[0] == '#') continue;
    if (line[0] == '>') {
      std::string cmd = line.substr(1);
      while (!cmd.empty() && cmd[0] == ' ') cmd.erase(0, 1);
      printf("\n>>>>>>>> %s\n", cmd.c_str());
      handleCommand(cmd.c_str());
    } else if (line.rfind("@advance ", 0) == 0) fakeMs += std::stoul(line.substr(9));
    else if (line == "@tick") checkReservationTimeouts();
    else if (line == "@jsonout") printf("[JSON] %s\n", buildStateJson().c_str());
    else if (line.rfind("@print ", 0) == 0) printf("%s\n", line.substr(7).c_str());
    else if (line == "@arrive") { printf("\n>>>>>>>> [sensor] spot 0 confirmed ARRIVE\n"); spotSensedStable = true; onSpotSensorArrive(20.0f); }
    else if (line == "@leave") { printf("\n>>>>>>>> [sensor] spot 0 confirmed LEAVE\n"); spotSensedStable = false; onSpotSensorLeave(26.0f); }
  }
  return 0;
}

int main(int argc, char** argv) {
  osBinaryStdout();
  if (argc >= 3 && !strcmp(argv[1], "--script")) {
    setvbuf(stdout, NULL, _IOFBF, 1 << 16);       // batch: nobody is waiting for each character, so buffer (fast)
    int rc = runScript(argv[2]);
    fflush(stdout);
    return rc;
  }
  setvbuf(stdout, NULL, _IONBF, 0);               // interactive: every character goes out at once, like a UART
  realClock = true;
  startMs = osNowMs();
  setup();
  while (!stdinEof) { loop(); osSleepMs(1); }
  return 0;
}
